## sdkconfig.defaults
```kconfig
CONFIG_FREERTOS_HZ=1000
CONFIG_PARTITION_TABLE_CUSTOM=y
CONFIG_PARTITION_TABLE_CUSTOM_FILENAME="partitions_4mb_noota.csv"
CONFIG_PARTITION_TABLE_FILENAME="partitions_4mb_noota.csv"
CONFIG_ESPTOOLPY_FLASHSIZE_4MB=y
```
